/*****************************************************************
* Copyright (C) 2019 Technology Co.,Ltd.*
******************************************************************
* control.c
*
* DESCRIPTION:
*     Control
* AUTHOR:
*     Ziming
* CREATED DATE:
*     2019/3/10
* REVISION:
*     v0.1
*
* MODIFICATION HISTORY
* --------------------
* $Log:$
*
*****************************************************************/
/*************************************************************************************************************************
 *                                                       INCLUDES                                                        *
 *************************************************************************************************************************/
#include "main.h"
#include "stm32f1xx_hal.h"
#include "gpio.h"
#include "ld3320.h"
#include "control.h"
/*************************************************************************************************************************
 *                                                        MACROS                                                         *
 *************************************************************************************************************************/
 
/*************************************************************************************************************************
 *                                                      CONSTANTS                                                        *
 *************************************************************************************************************************/
 
/*************************************************************************************************************************
 *                                                       TYPEDEFS                                                        *
 *************************************************************************************************************************/
 
/*************************************************************************************************************************
 *                                                   GLOBAL VARIABLES                                                    *
 *************************************************************************************************************************/
uint16_t weakStatus = 0;
static E_command g_command;
/*************************************************************************************************************************
 *                                                  EXTERNAL VARIABLES                                                   *
 *************************************************************************************************************************/
 
/*************************************************************************************************************************
 *                                                    LOCAL VARIABLES                                                    *
 *************************************************************************************************************************/
 
/*************************************************************************************************************************
 *                                                 FUNCTION DECLARATIONS                                                 *
 *************************************************************************************************************************/
static void     buzzer( uint8_t a_type );
static void     lightControl( uint8_t a_enable );
static void     delay( uint32_t time );
/*************************************************************************************************************************
 *                                                   PUBLIC FUNCTIONS                                                    *
 *************************************************************************************************************************/
 
/*************************************************************************************************************************
 *                                                    LOCAL FUNCTIONS                                                    *
 *************************************************************************************************************************/
/*****************************************************************
* DESCRIPTION: control
*     
* INPUTS:
*     
* OUTPUTS:
*     
* NOTE:
*     null
*****************************************************************/
void control( uint8_t a_command )
{
    g_command = a_command;
    switch(a_command)
    {
    case WEAK_UP:
        weakStatus = 10000;
        buzzer(2);
        break;
    case OPEN_LIGHT:
        if( weakStatus )
        {
            weakStatus = 10000;
            lightControl(1);
            buzzer(1);
        }
        break;
    case CLOSE_LIGHT:
        if( weakStatus )
        {
            weakStatus = 10000;
            lightControl(0);
            buzzer(1);
        }
        break;
    default :
        break;
    }
}

/*****************************************************************
* DESCRIPTION: buzzer
*     
* INPUTS:
*     
* OUTPUTS:
*     
* NOTE:
*     null
*****************************************************************/
static void buzzer( uint8_t a_type )
{
    for(uint16_t m = 0;m < a_type; m++)
    {
        HAL_GPIO_WritePin(BUZZER_GPIO_Port, BUZZER_Pin, GPIO_PIN_SET);		
        delay(5);
        HAL_GPIO_WritePin(BUZZER_GPIO_Port, BUZZER_Pin, GPIO_PIN_RESET);
        delay(10);
    }
    HAL_GPIO_WritePin(BUZZER_GPIO_Port, BUZZER_Pin, GPIO_PIN_RESET);
}

/*****************************************************************
* DESCRIPTION: lightControl
*     
* INPUTS:
*     
* OUTPUTS:
*     
* NOTE:
*     null
*****************************************************************/
static void lightControl( uint8_t a_enable )
{
    if( a_enable )
    {
        HAL_GPIO_WritePin(Light_GPIO_Port, Light_Pin, GPIO_PIN_SET);
    }
    else
    {
        HAL_GPIO_WritePin(Light_GPIO_Port, Light_Pin, GPIO_PIN_RESET);
    }
}

/*****************************************************************
* DESCRIPTION: delay
*     
* INPUTS:
*     
* OUTPUTS:
*     
* NOTE:
*     null
*****************************************************************/
static void delay( uint32_t time )
{
    for( uint32_t count = 0; count < time; count++ )
        for(uint32_t cnt = 0; cnt < 10000; cnt++ );
}
/****************************************************** END OF FILE ******************************************************/
